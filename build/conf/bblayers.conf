## build/conf/bblayers.conf
```bitbake
# POKY_BBLAYERS_CONF_VERSION is increased each time build/conf/bblayers.conf
# changes incompatibly
POKY_BBLAYERS_CONF_VERSION = "2"

BBPATH = "${TOPDIR}"
BBFILES ?= ""

BBLAYERS ?= " \
  /home/louati/Studium/Linux/Buildtoolshain/YOCTO/poky/meta \
  /home/louati/Studium/Linux/Buildtoolshain/YOCTO/poky/meta-poky \
  /home/louati/Studium/Linux/Buildtoolshain/YOCTO/poky/meta-yocto-bsp \
  /home/louati/Studium/Linux/Buildtoolshain/YOCTO/meta-raspberrypi \
  /home/louati/Studium/Linux/Buildtoolshain/YOCTO/meta-openembedded/meta-oe \
  /home/louati/Studium/Linux/Buildtoolshain/YOCTO/meta-openembedded/meta-multimedia \
  /home/louati/Studium/Linux/Buildtoolshain/YOCTO/meta-openembedded/meta-networking \
  /home/louati/Studium/Linux/Buildtoolshain/YOCTO/meta-openembedded/meta-python \
  /home/louati/Studium/Linux/Buildtoolshain/YOCTO/meta-custom \
  "
```
